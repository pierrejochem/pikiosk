## Config.in
```kconfig
source "$BR2_EXTERNAL_PIKIOSK_PATH/package/kiosk-ui/Config.in"
source "$BR2_EXTERNAL_PIKIOSK_PATH/package/kioskd/Config.in"
```

## package/kiosk-ui/Config.in
```kconfig
config BR2_PACKAGE_KIOSK_UI
	bool "kiosk-ui"
	depends on BR2_PACKAGE_HOST_RUSTC_TARGET_ARCH_SUPPORTS
	depends on BR2_PACKAGE_HAS_LIBEGL
	depends on BR2_PACKAGE_HAS_LIBGLES
	depends on BR2_PACKAGE_HAS_LIBGBM
	depends on BR2_PACKAGE_HAS_UDEV
	select BR2_PACKAGE_HOST_RUSTC
	select BR2_PACKAGE_LIBINPUT
	help
	  Fullscreen kiosk application written in Rust with egui:
	  liquid-glass panels and controls rendered with GLES 2 on
	  DRM/KMS, touch/mouse/keyboard via libinput.

comment "kiosk-ui needs EGL, GLES, GBM and udev (systemd)"
	depends on BR2_PACKAGE_HOST_RUSTC_TARGET_ARCH_SUPPORTS
	depends on !BR2_PACKAGE_HAS_LIBEGL || !BR2_PACKAGE_HAS_LIBGLES || \
		!BR2_PACKAGE_HAS_LIBGBM || !BR2_PACKAGE_HAS_UDEV
```

## package/kioskd/Config.in
```kconfig
config BR2_PACKAGE_KIOSKD
	bool "kioskd"
	depends on BR2_PACKAGE_HOST_RUSTC_TARGET_ARCH_SUPPORTS
	select BR2_PACKAGE_HOST_RUSTC
	help
	  Root daemon of the pikiosk app store. Starts apps as systemd
	  units, hands the display between kiosk-ui and the running app,
	  and watches for the Home gesture.

comment "kioskd needs a Rust-capable architecture"
	depends on !BR2_PACKAGE_HOST_RUSTC_TARGET_ARCH_SUPPORTS
```
